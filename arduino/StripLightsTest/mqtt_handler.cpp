#include "mqtt_handler.h"
#include "strip_api.h"

#include "WiFiS3.h"
#include "WiFiSSLClient.h"
#include "ArduinoMqttClient.h"
#include "ArduinoGraphics.h"
#include "Arduino_LED_Matrix.h"

const char broker[] = "157f4ec42861480695b95d99a47d8ae4.s1.eu.hivemq.cloud";
const int  port     = 8883;

const char subscribeTopic[] = "arduino/in";
const char publishTopic[]   = "arduino/out";

// WiFi + MQTT credentials — generated by run.sh from .envrc
#include "credentials.h"

ArduinoLEDMatrix matrix;
WiFiSSLClient wifiClient;
MqttClient mqttClient(wifiClient);

int wifiStatus = WL_IDLE_STATUS;
char statusText[2] = "1";

static void refreshMatrix() {
  matrix.beginDraw();
  matrix.stroke(0xFFFFFFFF);
  matrix.textFont(Font_5x7);
  matrix.text(statusText, 3, 1);
  matrix.endDraw();
}

static void setStatus(char code) {
  statusText[0] = code;
  statusText[1] = '\0';
  refreshMatrix();
}

// ── JSON helpers ──────────────────────────────────────────────────────────

// Find a quoted string value for a given key in a JSON payload.
// e.g. findJsonString(payload, "scene") returns pointer to start of value
// (after the opening quote), or NULL if not found.
// The caller must null-terminate before using.
static const char* findJsonString(const char* json, const char* key) {
  char buf[64];
  snprintf(buf, sizeof(buf), "\"%s\"", key);
  const char* kp = strstr(json, buf);
  if (!kp) return NULL;
  kp += strlen(buf);            // skip past "key"
  while (*kp && *kp != ':') kp++;  // skip to colon
  if (!*kp) return NULL;
  kp++;                          // skip colon
  while (*kp == ' ') kp++;       // skip whitespace
  if (*kp == '"') return kp + 1; // skip opening quote, return start of value
  return NULL;
}

// Find an integer value for a given key in a JSON payload.
static int findJsonInt(const char* json, const char* key, int defaultValue) {
  char buf[64];
  snprintf(buf, sizeof(buf), "\"%s\"", key);
  const char* kp = strstr(json, buf);
  if (!kp) return defaultValue;
  kp += strlen(buf);
  while (*kp && *kp != ':') kp++;
  if (!*kp) return defaultValue;
  kp++;
  while (*kp == ' ') kp++;
  return atoi(kp);
}

// Find a boolean value for a given key in a JSON payload.
static bool findJsonBool(const char* json, const char* key, bool defaultValue) {
  char buf[64];
  snprintf(buf, sizeof(buf), "\"%s\":", key);
  const char* kp = strstr(json, buf);
  if (!kp) return defaultValue;
  kp += strlen(buf);
  while (*kp == ' ') kp++;
  return (strncmp(kp, "true", 4) == 0);
}

// Extract a quoted string value into a buffer.
// Caller provides dest buffer of size destSize.
// Returns true on success.
static bool extractJsonString(const char* json, const char* key, char* dest, size_t destSize) {
  const char* start = findJsonString(json, key);
  if (!start) return false;
  size_t i = 0;
  while (*start && *start != '"' && i < destSize - 1) {
    dest[i++] = *start++;
  }
  dest[i] = '\0';
  return true;
}

// ── State publishing ──────────────────────────────────────────────────────

static void publishState() {
  uint8_t r, g, b;
  strip_get_color(&r, &g, &b);

  // Build full state JSON
  char json[160];
  snprintf(json, sizeof(json),
    "{\"on\":%s,\"brightness\":%d,\"scene\":\"%s\",\"r\":%d,\"g\":%d,\"b\":%d}",
    is_strip_on() ? "true" : "false",
    strip_get_brightness(),
    strip_get_scene(),
    r, g, b);

  Serial.print("Publishing state: ");
  Serial.println(json);

  mqttClient.beginMessage(publishTopic);
  mqttClient.print(json);
  mqttClient.endMessage();
}

// ── MQTT message handler ──────────────────────────────────────────────────

static void onMqttMessage(int messageSize) {
  Serial.print("Received message on topic: ");
  Serial.println(mqttClient.messageTopic());

  // Read full payload
  char payload[256];
  int idx = 0;
  while (mqttClient.available() && idx < (int)sizeof(payload) - 1) {
    payload[idx++] = (char)mqttClient.read();
  }
  payload[idx] = '\0';

  Serial.print("Payload: ");
  Serial.println(payload);

  // Extract action
  char action[32] = {0};
  if (!extractJsonString(payload, "action", action, sizeof(action))) {
    Serial.println("No action field in message");
    return;
  }

  bool stateChanged = false;

  if (strcmp(action, "toggle") == 0) {
    strip_toggle();
    stateChanged = true;
  } else if (strcmp(action, "on") == 0) {
    strip_on();
    stateChanged = true;
  } else if (strcmp(action, "off") == 0) {
    strip_off();
    stateChanged = true;
  } else if (strcmp(action, "set_scene") == 0) {
    char scene[32] = {0};
    if (extractJsonString(payload, "scene", scene, sizeof(scene))) {
      strip_set_scene(scene);
      stateChanged = true;
    }
  } else if (strcmp(action, "set_brightness") == 0) {
    int val = findJsonInt(payload, "brightness", -1);
    if (val >= 0 && val <= 255) {
      strip_set_brightness((uint8_t)val);
      stateChanged = true;
    }
  } else if (strcmp(action, "set_color") == 0) {
    int r = findJsonInt(payload, "r", -1);
    int g = findJsonInt(payload, "g", -1);
    int b = findJsonInt(payload, "b", -1);
    if (r >= 0 && g >= 0 && b >= 0) {
      strip_set_color((uint8_t)r, (uint8_t)g, (uint8_t)b);
      stateChanged = true;
    }
  } else if (strcmp(action, "set_pixel") == 0) {
    int index = findJsonInt(payload, "index", -1);
    if (index >= 0) {
      strip_set_single_led_pixel(index);
      strip_set_scene("single-led");
      stateChanged = true;
    }
  } else if (strcmp(action, "get_state") == 0) {
    publishState();
    return;  // already published, no need to publish again below
  } else {
    Serial.print("Unknown action: ");
    Serial.println(action);
  }

  if (stateChanged) {
    publishState();
  }
}

// ── WiFi helpers ──────────────────────────────────────────────────────────

static void printWifiStatus() {
  Serial.println(F("WiFi Firmware Version: "));
  Serial.println(WiFi.firmwareVersion());
  Serial.print(F("SSID: "));
  Serial.println(WiFi.SSID());
  Serial.print(F("IP: "));
  Serial.println(WiFi.localIP());
  Serial.print(F("RSSI: "));
  Serial.print(WiFi.RSSI());
  Serial.println(F(" dBm"));
}

// ── Setup ─────────────────────────────────────────────────────────────────

void mqtt_setup() {
  Serial.begin(115200);
  while (!Serial) {
    ;
  }

  Serial.println(F("\n=== StripLightsTest (MQTT) ==="));

  matrix.begin();
  setStatus('1');

  if (WiFi.status() == WL_NO_MODULE) {
    Serial.println(F("WiFi module not found"));
    setStatus('E');
    while (true) {
      delay(1000);
    }
  }

  Serial.print(F("Firmware: "));
  Serial.println(WiFi.firmwareVersion());

  setStatus('2');
  WiFi.setHostname("Arduino");
  while (wifiStatus != WL_CONNECTED) {
    Serial.print(F("Connecting to "));
    Serial.println(wifi_ssid);
    wifiStatus = WiFi.begin(wifi_ssid, wifi_pass);
    if (wifiStatus != WL_CONNECTED) {
      delay(2000);
    }
  }

  Serial.print(F("Waiting for IP"));
  unsigned long dhcpStart = millis();
  while (WiFi.localIP() == IPAddress(0, 0, 0, 0)) {
    if (millis() - dhcpStart > 30000) {
      Serial.println(F("\nDHCP failed"));
      setStatus('E');
      while (true) {
        delay(1000);
      }
    }
    delay(500);
    Serial.print('.');
  }
  Serial.println();

  printWifiStatus();

  // MQTT setup
  mqttClient.setId("ArduinoR4-StripLights");
  mqttClient.setUsernamePassword(mqtt_user, mqtt_pass);
  mqttClient.onMessage(onMqttMessage);

  Serial.print(F("Connecting to MQTT broker: "));
  Serial.print(broker);
  Serial.print(F(":"));
  Serial.println(port);

  if (!mqttClient.connect(broker, port)) {
    Serial.print(F("ERROR: MQTT connection failed! Error code = "));
    Serial.println(mqttClient.connectError());
    setStatus('E');
    while (true) {
      delay(1000);
    }
  }

  Serial.println(F("Connected to MQTT broker!"));

  mqttClient.subscribe(subscribeTopic);
  Serial.print(F("Subscribed to: "));
  Serial.println(subscribeTopic);

  setStatus('3');
  Serial.println(F("MQTT handler ready"));

  // Publish initial state
  publishState();
}

// ── Loop ──────────────────────────────────────────────────────────────────

void mqtt_loop() {
  mqttClient.poll();
}